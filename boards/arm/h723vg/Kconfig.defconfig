## boards/arm/h723vg/Kconfig.defconfig
```kconfig
# STM32H723VG board configuration

# Copyright (c) 2024 Krzysztof Gawryś

if BOARD_H723VG

config BOARD
	default "custom_h723vg"

endif # BOARD_H723VG
```

## boards/arm/h723vg/Kconfig.h723vg
```kconfig
# STM32H723VG board configuration

# Copyright (c) 2024 Krzysztof Gawryś

config BOARD_H723VG
        bool "H723VG Development Board"
        select SOC_STM32H723XX
```

## boards/arm/h723vg/h723vg_defconfig
```kconfig
# SPDX-License-Identifier: Apache-2.0

CONFIG_SOC_SERIES_STM32H7X=y
CONFIG_SOC_STM32H723XX=y

CONFIG_BOARD_H723VG=y

# Enable MPU
CONFIG_ARM_MPU=y
CONFIG_DCACHE=y
CONFIG_ICACHE=y

# Enable UART
CONFIG_SERIAL=y

# Console
CONFIG_CONSOLE=y
CONFIG_UART_CONSOLE=y

# Enable GPIO
CONFIG_GPIO=y

# Enable Clock
CONFIG_CLOCK_CONTROL=y

# enable pin controller
CONFIG_PINCTRL=y

CONFIG_DEBUG_OPTIMIZATIONS=y
CONFIG_COMPILER_OPT="-O2"

CONFIG_FLASH_SIZE=1024
CONFIG_FLASH_BASE_ADDRESS=0x08000000
CONFIG_SRAM_SIZE=320
CONFIG_SRAM_BASE_ADDRESS=0x24000000

CONFIG_ISR_STACK_SIZE=16384
CONFIG_MAIN_STACK_SIZE=32768
```

## boards/arm/weact_h723vg/Kconfig.board
```kconfig
# STM32H723VG WeAct board configuration

# Copyright (c) 2024 Krzysztof Gawryś

config BOARD_WEACT_H723VG
	bool "H723VG Development Board"
	depends on SOC_STM32H723XX
```

## boards/arm/weact_h723vg/Kconfig.defconfig
```kconfig
# STM32H723VG WeAct board configuration

# Copyright (c) 2024 Krzysztof Gawryś

if BOARD_WEACT_H723VG

config BOARD
	default "weact_h723vg"

endif # BOARD_WEACT_H723VG
```
